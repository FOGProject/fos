## Buildroot/package/partclone/Config.in
```kconfig
config BR2_PACKAGE_PARTCLONE
	bool "partclone"
	help
	  Partclone
	  The Free and Open Source Software for Partition Imaging and Cloning

	  http://partclone.org

comment "partclone requires a toolchain with LARGEFILE+WCHAR support"
```

## KernelPackages/drivers/net/ethernet/realtek/Kconfig
```kconfig
source "drivers/net/ethernet/realtek/r8125/Kconfig"
source "drivers/net/ethernet/realtek/r8126/Kconfig"
source "drivers/net/ethernet/realtek/r8127/Kconfig"
source "drivers/net/ethernet/realtek/r8168/Kconfig"
```

## KernelPackages/drivers/net/ethernet/realtek/r8125/Kconfig
```kconfig
config R8125
    tristate "Realtek 2.5G Ethernet driver (r8125)"
    depends on PCI && MII
    help
      This is the official Realtek 2.5G Ethernet driver. 
```

## KernelPackages/drivers/net/ethernet/realtek/r8126/Kconfig
```kconfig
config R8126
    tristate "Realtek 5G Ethernet driver (r8126)"
    depends on PCI && MII
    help
      This is the official Realtek 5G Ethernet driver. 
```

## KernelPackages/drivers/net/ethernet/realtek/r8127/Kconfig
```kconfig
config R8127
    tristate "Realtek 10G Ethernet driver (r8127)"
    depends on PCI && MII
    help
      This is the official Realtek 10G Ethernet driver. 
```

## KernelPackages/drivers/net/ethernet/realtek/r8168/Kconfig
```kconfig
config R8168
    tristate "Realtek GBE Ethernet driver (r8168)"
    depends on PCI && MII
    help
      This is the official Realtek GBE Ethernet driver. 
```
